## conf/distro/XaDeOS.conf
```bitbake
require conf/distro/poky.conf

DISTRO="XaDeOS"
DISTRO_NAME="${DISTRO}"
DISTRO_VERSION="0.0.1"
DISTRO_CODENAME="${DISTRO}"
```

## conf/layer.conf
```bitbake
require documentation.conf

# We have a conf and classes directory, add to BBPATH
BBPATH .= ":${LAYERDIR}"

# We have recipes-* directories, add to BBFILES
BBFILES += "${LAYERDIR}/recipes-*/*/*.bb"
BBFILES += "${LAYERDIR}/recipes-*/*/*.bbappend"

BBFILE_COLLECTIONS += "meta-xade"
BBFILE_PATTERN_meta-xade = "^${LAYERDIR}/"
BBFILE_PRIORITY_meta-xade = "7"

LAYERSDEPENDS += "meta-raspberrypi"

LAYERVERSION = "1"
```

## conf/local.conf.sample
```bitbake
PARALLEL_MAKE = "-j ${@oe.utils.cpu_count()}"
BB_NUMBER_THREADS = "${@oe.utils.cpu_count()}"
DISTRO = "XaDeOS"
MACHINE ?= "imx6ulevk"
```

## conf/machine/raspberry-pi-3.conf
```bitbake
#@TYPE: Machine
#@NAME: RaspberryPi 3 WiFi development board
#@DESCRIPTION: Machine configuration for the RaspberryPi 3 board

require conf/machine/raspberrypi3.conf
```

## conf/machine/raspberry-pi-zero-wifi.conf
```bitbake
#@TYPE: Machine
#@NAME: RaspberryPi Zero WiFi development board
#@DESCRIPTION: Machine configuration for the RaspberryPi Zero WiFi board (https://www.raspberrypi.org/blog/raspberry-pi-zero-w-joins-family/)

require conf/machine/raspberrypi0-wifi.conf
```
